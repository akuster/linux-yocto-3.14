## arch/powerpc/platforms/qemu/Kconfig
```kconfig
config PPC_QEMU
	bool "QEMU emulated PowerPC Reference Platform (PReP) system"
	depends on PPC32
	select PPC_I8259
	select PPC_INDIRECT_PCI
	select PPC_UDBG_16550
	select PPC_NATIVE
	select WANT_DEVICE_TREE
	default n
```
